## board/sifive/hifive-unleashed/kernel.its
```
/dts-v1/;
/ {
	description = "FIT image with single Linux kernel, FDT blob";
	#address-cells = <1>;

	images {
		kernel@0 {
			description = "RISC-V Linux kernel";
			data = /incbin/("./Image.gz");
			type = "kernel";
			arch = "riscv";
			os = "linux";
			compression = "gzip";
			load = <0xA4000000>;
			entry = <0xA4000000>;
		};

		fdt@0 {
			description = "HiFive Unleashed A00 blob";
			data = /incbin/("./hifive-unleashed-a00.dtb");
			type = "flat_dt";
			arch = "riscv";
			compression = "none";
		};
	};

	configurations {
		default = "conf@0";

		conf@0 {
			description = "Boot Linux kernel, FDT blob";
			kernel = "kernel@0";
			fdt = "fdt@0";
		};
	};
};
```

## configs/engicam_imx6qdl_icore_qt5_gst1_defconfig
```kconfig
BR2_arm=y
BR2_cortex_a9=y
BR2_ARM_ENABLE_NEON=y
BR2_ARM_ENABLE_VFP=y
BR2_ARM_FPU_VFPV3=y

# Linux headers same as kernel, a 4.13 series
BR2_PACKAGE_HOST_LINUX_HEADERS_CUSTOM_4_13=y

# System
BR2_TARGET_GENERIC_GETTY_PORT="ttymxc3"

# Bootloader
BR2_TARGET_UBOOT=y
BR2_TARGET_UBOOT_BUILD_SYSTEM_KCONFIG=y
BR2_TARGET_UBOOT_CUSTOM_VERSION=y
BR2_TARGET_UBOOT_CUSTOM_VERSION_VALUE="2017.07"
BR2_TARGET_UBOOT_BOARD_DEFCONFIG="imx6qdl_icore_mmc"
BR2_TARGET_UBOOT_NEEDS_DTC=y
BR2_TARGET_UBOOT_NEEDS_OPENSSL=y
BR2_TARGET_UBOOT_FORMAT_DTB_IMG=y
BR2_TARGET_UBOOT_SPL=y
BR2_TARGET_UBOOT_SPL_NAME="SPL"

# Kernel
BR2_LINUX_KERNEL=y
BR2_LINUX_KERNEL_CUSTOM_GIT=y
BR2_LINUX_KERNEL_CUSTOM_REPO_URL="https://github.com/openedev/linux-openedev"
BR2_LINUX_KERNEL_CUSTOM_REPO_VERSION="engicam"
BR2_LINUX_KERNEL_DEFCONFIG="imx_v6_v7"
BR2_LINUX_KERNEL_UIMAGE=y
BR2_LINUX_KERNEL_UIMAGE_LOADADDR="0x10008000"
BR2_LINUX_KERNEL_DTS_SUPPORT=y
BR2_LINUX_KERNEL_INTREE_DTS_NAME="imx6dl-icore imx6q-icore imx6q-icore-ofcap10 imx6q-icore-ofcap12"

# Filesystem
BR2_TARGET_GENERIC_ISSUE="Welcome to Engicam i.CoreM6 Quad/Dual/DualLite/Solo"
BR2_TARGET_ROOTFS_EXT2=y
BR2_TARGET_ROOTFS_EXT2_4=y
BR2_TARGET_ROOTFS_EXT2_SIZE="512M"
BR2_PACKAGE_HOST_DOSFSTOOLS=y
BR2_PACKAGE_HOST_GENIMAGE=y
BR2_PACKAGE_HOST_MTOOLS=y
BR2_ROOTFS_POST_IMAGE_SCRIPT="support/scripts/genimage.sh"
BR2_ROOTFS_POST_SCRIPT_ARGS="-c board/engicam/icorem6/genimage.cfg"
BR2_ROOTFS_OVERLAY="board/engicam/icorem6/rootfs_overlay"

# qt5 dependencies
BR2_TOOLCHAIN_BUILDROOT_WCHAR=y
BR2_TOOLCHAIN_BUILDROOT_CXX=y

# qt5
BR2_PACKAGE_QT5=y
BR2_PACKAGE_QT5BASE_LICENSE_APPROVED=y
BR2_PACKAGE_QT5BASE_OPENGL_LIB=y
BR2_PACKAGE_QT5BASE_LINUXFB=y
BR2_PACKAGE_QT5BASE_FONTCONFIG=y
BR2_PACKAGE_QT5BASE_GIF=y
BR2_PACKAGE_QT5BASE_JPEG=y

# mesa3d
BR2_PACKAGE_MESA3D=y
BR2_PACKAGE_MESA3D_GALLIUM_DRIVER_ETNAVIV=y
BR2_PACKAGE_MESA3D_GALLIUM_DRIVER_SWRAST=y
BR2_PACKAGE_MESA3D_OPENGL_ES=y

# qt5 demo packages
BR2_PACKAGE_GLMARK2=y
BR2_PACKAGE_MESA3D_DEMOS=y
BR2_PACKAGE_KMSCUBE=y
BR2_PACKAGE_QT5CINEX=y
BR2_PACKAGE_QT5CINEX_HD=y

# fonts
BR2_PACKAGE_BITSTREAM_VERA=y
BR2_PACKAGE_CANTARELL=y
BR2_PACKAGE_DEJAVU=y
BR2_PACKAGE_FONT_AWESOME=y
BR2_PACKAGE_GHOSTSCRIPT_FONTS=y
BR2_PACKAGE_INCONSOLATA=y
BR2_PACKAGE_LIBERATION=y

# libdrm tests
BR2_PACKAGE_LIBDRM_INSTALL_TESTS=y

# NXP packages
BR2_PACKAGE_FREESCALE_IMX=y
BR2_PACKAGE_FREESCALE_IMX_PLATFORM_IMX6Q=y
BR2_PACKAGE_FIRMWARE_IMX=y

# gstreamer-1.0
BR2_PACKAGE_GSTREAMER1=y
BR2_PACKAGE_GST1_LIBAV=y
BR2_PACKAGE_GST1_PLUGINS_BASE_PLUGIN_ADDER=y
BR2_PACKAGE_GST1_PLUGINS_BASE_PLUGIN_AUDIORATE=y
BR2_PACKAGE_GST1_PLUGINS_BASE_PLUGIN_VIDEOCONVERT=y
BR2_PACKAGE_GST1_PLUGINS_BASE_PLUGIN_RAWPARSE=y
BR2_PACKAGE_GST1_PLUGINS_BASE_PLUGIN_SUBPARSE=y
BR2_PACKAGE_GST1_PLUGINS_BASE_PLUGIN_ALSA=y
BR2_PACKAGE_GST1_PLUGINS_BASE_PLUGIN_VORBIS=y
BR2_PACKAGE_GST1_PLUGINS_GOOD_PLUGIN_AUDIOFX=y
BR2_PACKAGE_GST1_PLUGINS_GOOD_PLUGIN_AUDIOPARSERS=y
BR2_PACKAGE_GST1_PLUGINS_GOOD_PLUGIN_AUTODETECT=y
BR2_PACKAGE_GST1_PLUGINS_GOOD_PLUGIN_DEINTERLACE=y
BR2_PACKAGE_GST1_PLUGINS_GOOD_PLUGIN_MATROSKA=y
BR2_PACKAGE_GST1_PLUGINS_GOOD_PLUGIN_Y4M=y
BR2_PACKAGE_GST1_PLUGINS_GOOD_PLUGIN_V4L2=y
BR2_PACKAGE_GST1_PLUGINS_BAD=y
BR2_PACKAGE_GST1_PLUGINS_BAD_LIB_OPENGL=y
BR2_PACKAGE_GST1_PLUGINS_BAD_PLUGIN_AUTOCONVERT=y
BR2_PACKAGE_GST1_PLUGINS_BAD_PLUGIN_FBDEV=y
BR2_PACKAGE_GST1_PLUGINS_BAD_PLUGIN_KMS=y
BR2_PACKAGE_GST1_PLUGINS_BAD_PLUGIN_MPEGDEMUX=y
BR2_PACKAGE_GST1_PLUGINS_BAD_PLUGIN_MPEGTSDEMUX=y
BR2_PACKAGE_GST1_PLUGINS_BAD_PLUGIN_SMOOTH=y
BR2_PACKAGE_GST1_PLUGINS_BAD_PLUGIN_STEREO=y
BR2_PACKAGE_GST1_PLUGINS_BAD_PLUGIN_Y4M=y
BR2_PACKAGE_GST1_PLUGINS_BAD_PLUGIN_NEON=y
BR2_PACKAGE_GST1_PLUGINS_BAD_PLUGIN_OPENH264=y
BR2_PACKAGE_GST1_PLUGINS_UGLY=y
BR2_PACKAGE_GST1_PLUGINS_UGLY_PLUGIN_MPG123=y
BR2_PACKAGE_GST1_PLUGINS_UGLY_PLUGIN_X264=y
```

## configs/hifive_unleashed_spi_defconfig
```kconfig
# Architecture
BR2_riscv=y
BR2_riscv_custom=y
BR2_RISCV_ISA_CUSTOM_RVM=y
BR2_RISCV_ISA_CUSTOM_RVF=y
BR2_RISCV_ISA_CUSTOM_RVD=y
BR2_RISCV_ISA_CUSTOM_RVC=y
BR2_RISCV_64=y
BR2_RISCV_ABI_LP64D=y

# System
BR2_SYSTEM_DHCP="eth0"
BR2_TARGET_GENERIC_GETTY=y
BR2_TARGET_GENERIC_GETTY_PORT="ttySIF0"
BR2_ROOTFS_POST_BUILD_SCRIPT="board/sifive/hifive-unleashed/post-build.sh"

# Filesystem
BR2_TARGET_ROOTFS_INITRAMFS=y
BR2_TARGET_ROOTFS_CPIO_GZIP=y

# Linux headers same as kernel, a 5.6 series
BR2_PACKAGE_HOST_LINUX_HEADERS_CUSTOM_5_6=y

# Kernel
BR2_LINUX_KERNEL=y
BR2_LINUX_KERNEL_CUSTOM_VERSION=y
BR2_LINUX_KERNEL_CUSTOM_VERSION_VALUE="5.6"
BR2_LINUX_KERNEL_USE_ARCH_DEFAULT_CONFIG=y
BR2_LINUX_KERNEL_DTS_SUPPORT=y
BR2_LINUX_KERNEL_INTREE_DTS_NAME="sifive/hifive-unleashed-a00"
BR2_LINUX_KERNEL_IMAGE_TARGET_CUSTOM=y
BR2_LINUX_KERNEL_IMAGE_TARGET_NAME="Image.gz"
BR2_LINUX_KERNEL_CONFIG_FRAGMENT_FILES="board/sifive/hifive-unleashed/linux_mtd.fragment"
BR2_LINUX_KERNEL_NEEDS_HOST_OPENSSL=y

# opensbi
BR2_TARGET_OPENSBI=y
BR2_TARGET_OPENSBI_PLAT="sifive/fu540"
BR2_TARGET_OPENSBI_FW_DYNAMIC=y

# Bootloader
BR2_TARGET_UBOOT=y
BR2_TARGET_UBOOT_BUILD_SYSTEM_KCONFIG=y
BR2_TARGET_UBOOT_CUSTOM_TARBALL=y
BR2_TARGET_UBOOT_CUSTOM_TARBALL_LOCATION="$(call github,amarula,u-boot-amarula)v2.0-hifive-unleashed.tar.gz"
BR2_TARGET_UBOOT_BOARD_DEFCONFIG="sifive_fu540_spi"
BR2_TARGET_UBOOT_NEEDS_DTC=y
BR2_TARGET_UBOOT_NEEDS_PYELFTOOLS=y
BR2_TARGET_UBOOT_NEEDS_OPENSBI_FW_DYNAMIC=y
BR2_TARGET_UBOOT_FORMAT_CUSTOM=y
BR2_TARGET_UBOOT_FORMAT_CUSTOM_NAME="u-boot.itb"
BR2_TARGET_UBOOT_SPL=y
BR2_TARGET_UBOOT_SPL_NAME="spl/u-boot-spl.bin"

# Host tools
BR2_PACKAGE_HOST_UBOOT_TOOLS=y
BR2_PACKAGE_HOST_UBOOT_TOOLS_FIT_SUPPORT=y

# GPT
BR2_TOOLCHAIN_BUILDROOT_CXX=y
BR2_PACKAGE_GPTFDISK=y
BR2_PACKAGE_GPTFDISK_SGDISK=y
BR2_PACKAGE_GPTFDISK_GDISK=y
```

## package/python-audioread/Config.in
```kconfig
config BR2_PACKAGE_PYTHON_AUDIOREAD
	bool "python-audioread"
	help
	  Python bindings for multi-library,
	  cross-platform audio decoding.

	  https://github.com/beetbox/audioread
```

## package/python-joblib/Config.in
```kconfig
config BR2_PACKAGE_PYTHON_JOBLIB
	bool "python-joblib"
	select BR2_PACKAGE_PYTHON_ZLIB if BR2_PACKAGE_PYTHON
	select BR2_PACKAGE_PYTHON3_ZLIB if BR2_PACKAGE_PYTHON3
	help
	  Joblib is a set of tools to provide lightweight
	  pipelining in Python.

	  https://github.com/joblib/joblib
```

## package/python-librosa/Config.in
```kconfig
config BR2_PACKAGE_PYTHON_LIBROSA
	bool "python-librosa"
	depends on BR2_PACKAGE_PYTHON3
	select BR2_PACKAGE_PYTHON_AUDIOREAD	# runtime, >= 2.0.0
	select BR2_PACKAGE_PYTHON_NUMPY		# runtime, >= 1.15.0
	select BR2_PACKAGE_PYTHON_SCIPY		# runtime, >= 1.0.0
	select BR2_PACKAGE_PYTHON_SCIKIT_LEARN	# runtime, >= 0.14.0, != 0.19.0
	select BR2_PACKAGE_PYTHON_JOBLIB	# runtime, >= 0.12
	select BR2_PACKAGE_PYTHON_DECORATOR	# runtime, >= 3.0.0
	select BR2_PACKAGE_PYTHON_RESAMPY	# runtime, >= 0.2.2
	select BR2_PACKAGE_PYTHON_NUMBA		# runtime, >= 0.43.0
	select BR2_PACKAGE_PYTHON_SOUNDFILE	# runtime, >= 0.9.0
	help
	  Python library for audio and music analysis.

	  https://github.com/librosa/librosa
```

## package/python-llvmlite/Config.in
```kconfig
config BR2_PACKAGE_PYTHON_LLVMLITE
	bool "python-llvmlite"
	select BR2_PACKAGE_LLVM
	help
	  A lightweight LLVM python binding for
	  writing JIT compilers.

	  https://github.com/numba/llvmlite
```

## package/python-numba/Config.in
```kconfig
config BR2_PACKAGE_PYTHON_NUMBA
	bool "python-numba"
	depends on BR2_PACKAGE_PYTHON3		# runtime, >= 3.6
	select BR2_PACKAGE_PYTHON_LLVMLITE      # runtime, >= 0.31.0dev0
	select BR2_PACKAGE_PYTHON_NUMPY		# runtime, >= 1.15
	select BR2_GCC_ENABLE_OPENMP
	help
	  NumPy aware dynamic Python compiler using LLVM.

	  https://github.com/numba/numba
```

## package/python-pybind11/Config.in.host
```kconfig
config BR2_PACKAGE_HOST_PYTHON_PYBIND11
	bool "host python-pybind11"
	help
	  Python module for Seamless operability between
	  C++11 and Python.

	  https://github.com/pybind/pybind11
```

## package/python-resampy/Config.in
```kconfig
config BR2_PACKAGE_PYTHON_RESAMPY
	bool "python-resampy"
	select BR2_PACKAGE_PYTHON_NUMPY		# runtime, >=1.10
	select BR2_PACKAGE_PYTHON_SCIPY		# runtime, >=0.13
	select BR2_PACKAGE_PYTHON_NUMBA		# runtime, >=0.32
	select BR2_PACKAGE_PYTHON_SIX		# runtime, >=1.3
	select BR2_PACKAGE_PYTHON_SETUPTOOLS	# runtime
	help
	  Python binding for Efficient sample rate conversion.

	  https://github.com/bmcfee/resampy
```

## package/python-scikit-learn/Config.in
```kconfig
config BR2_PACKAGE_PYTHON_SCIKIT_LEARN
	bool "python-scikit-learn"
	select BR2_PACKAGE_PYTHON_SCIPY		# runtime, >= 0.19.1
	select BR2_PACKAGE_PYTHON_NUMPY		# runtime, >= 1.13.3
	select BR2_PACKAGE_PYTHON_JOBLIB	# runtime, >= 0.11
	select BR2_PACKAGE_PYTHON_THREADPOOLCTL	# runtime, >= 2.0.0
	help
	  A set of python modules for machine learning and data mining.

	  https://github.com/scikit-learn/scikit-learn
```

## package/python-scipy/Config.in
```kconfig
config BR2_PACKAGE_PYTHON_SCIPY
	bool "python-scipy"
	depends on BR2_TOOLCHAIN_USES_GLIBC || BR2_TOOLCHAIN_USES_MUSL # python-numpy
	depends on BR2_TOOLCHAIN_HAS_FORTRAN
	depends on BR2_TOOLCHAIN_BUILDROOT_CXX
	depends on BR2_PACKAGE_PYTHON3
	select BR2_PACKAGE_PYTHON_NUMPY
	select BR2_PACKAGE_LAPACK
	select BR2_PACKAGE_OPENBLAS
	help
	  The SciPy library is one of the core packages that make up the SciPy
	  stack. It provides many user-friendly and efficient numerical
	  routines such as routines for numerical integration, interpolation,
	  optimization, linear algebra and statistics.

	  https://www.scipy.org/scipylib/

comment "python-scipy needs toolchain w/ fortran and c++ and glibc or musl"
	depends on BR2_PACKAGE_PYTHON3
	depends on !BR2_TOOLCHAIN_HAS_FORTRAN || \
		!BR2_TOOLCHAIN_BUILDROOT_CXX || \
		(!BR2_TOOLCHAIN_USES_GLIBC && !BR2_TOOLCHAIN_USES_MUSL)
```

## package/python-soundfile/Config.in
```kconfig
config BR2_PACKAGE_PYTHON_SOUNDFILE
	bool "python-soundfile"
	select BR2_PACKAGE_LIBSNDFILE
	select BR2_PACKAGE_PYTHON_CFFI # runtime
	help
	  Python bindings for SoundFile. SoundFile is an audio
	  library based on libsndfile, CFFI, and NumPy

	  https://github.com/bastibe/SoundFile
```

## package/python-threadpoolctl/Config.in
```kconfig
config BR2_PACKAGE_PYTHON_THREADPOOLCTL
	bool "python-threadpoolctl"
	help
	  Compiling Python code using LLVM.

	  https://github.com/numba/numba
```
